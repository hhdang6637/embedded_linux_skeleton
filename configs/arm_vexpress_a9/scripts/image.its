## configs/arm_vexpress_a9/scripts/image.its
```
/*
 * Simple U-Boot uImage source file containing a single kernel and FDT blob
 */

/dts-v1/;

/ {
    description = "U-Boot fitImage for sun8i-h2-plus-orangepi-zero";
    #address-cells = <1>;

    images {
        kernel-1 {
            description = "Linux kernel";
            data = /incbin/("./zImage");
            type = "kernel";
            arch = "arm";
            os = "linux";
            compression = "none";
            load = <0x42000000>;
            entry = <0x42000000>;
            hash-1 {
                algo = "sha1";
            };
        };

        fdt-1 {
            description = "Flattened Device Tree blob - Orange Pi Zero";
            data = /incbin/("./sun8i-h2-plus-orangepi-zero.dtb");
            type = "flat_dt";
            arch = "arm";
            compression = "none";
            load = <0x43000000>;
            entry = <0x43000000>;
            hash-1 {
                algo = "sha1";
            };
        };

        ramdisk-1 {
            description = "Ramdisk";
            data = /incbin/("./rootfs.cpio");
            type = "ramdisk";
            arch = "arm";
            os = "linux";
            compression = "none";
            load = <0x43300000>;
            entry = <0x43300000>;
            hash-1 {
                algo = "sha1";
            };
        };
    };

    configurations {
        default = "conf-1";
        conf-1 {
            description = "Boot Linux kernel with FDT blob conf-1";
            kernel = "kernel-1";
            ramdisk = "ramdisk-1";
            fdt = "fdt-1";
            hash-1 {
                algo = "sha1";
            };
        };
    };
};
```

## configs/pi_3_b/scripts/image.its
```
/dts-v1/;

/ {
    description = "U-Boot fitImage for bcm2835-rpi-b-plus";
    #address-cells = <1>;

    images {
        kernel@0 {
            description = "Linux Kernel";
            data = /incbin/("./zImage");
            type = "kernel";
            arch = "arm";
            os = "linux";
            compression = "none";
            load = <0x01000000>;
            entry = <0x01000000>;
            hash@1 {
                algo = "sha1";
            };
        };
        fdt@0 {
            description = "Flattened Device Tree blob - bcm2835";
            data = /incbin/("./bcm2837-rpi-3-b.dtb");
            type = "flat_dt";
            arch = "arm";
            compression = "none";
            hash@1 {
                algo = "sha1";
            };
        };
        ramdisk@0 {
            description = "ramdisk";
            data = /incbin/("./rootfs.cpio");
            type = "ramdisk";
            arch = "arm";
            os = "linux";
            load = <0x02100000>;
            entry = <0x02100000>;
            compression = "none";
            hash@1 {
                algo = "sha1";
            };
        };
    };
    configurations {
        default = "conf@1";
        conf@1 {
            description = "Boot Linux kernel with FDT blob + ramdisk";
            kernel = "kernel@0";
            fdt = "fdt@0";
            ramdisk = "ramdisk@0";
            hash@1 {
                algo = "sha1";
            };
        };
    };
};
```
